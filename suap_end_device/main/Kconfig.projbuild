## suap_end_device/main/Kconfig.projbuild
```kconfig
menu "Example Configuration"

    choice EXAMPLE_LCD_CONTROLLER
        prompt "LCD controller model"
        default EXAMPLE_LCD_CONTROLLER_ILI9341
        help
            Select LCD controller model

        config EXAMPLE_LCD_CONTROLLER_ILI9341
            bool "ILI9341"

        config EXAMPLE_LCD_CONTROLLER_GC9A01
            bool "GC9A01"
    endchoice

    config EXAMPLE_LCD_TOUCH_ENABLED
        bool "Enable LCD touch"
        default n
        help
            Enable this option if you wish to use display touch. You can select from touch controllers.

    choice EXAMPLE_LCD_TOUCH_CONTROLLER
        prompt "LCD touch controller model"
        depends on EXAMPLE_LCD_TOUCH_ENABLED
        default EXAMPLE_LCD_TOUCH_CONTROLLER_STMPE610
        help
            Select LCD touch controller model

        config EXAMPLE_LCD_TOUCH_CONTROLLER_STMPE610
            bool "STMPE610"
            help
                Touch controller STMPE610 connected via SPI.
    endchoice


    config EXAMPLE_CONNECT_WIFI
        bool "connect using WiFi interface"
        default y
        help
            Protocol examples can use Wi-Fi and/or Ethernet to connect to the network.
            Choose this option to connect with WiFi

    if EXAMPLE_CONNECT_WIFI
        config EXAMPLE_WIFI_SSID
            string "WiFi SSID"
            default "myssid"
            help
                SSID (network name) for the example to connect to.

        config EXAMPLE_WIFI_PASSWORD
            string "WiFi Password"
            default "mypassword"
            help
                WiFi password (WPA or WPA2) for the example to use.
                Can be left blank if the network has no security set.

        choice EXAMPLE_WIFI_SCAN_METHOD
            prompt "WiFi Scan Method"
            default EXAMPLE_WIFI_SCAN_METHOD_FAST
            help
                WiFi scan method:

                If "Fast" is selected, scan will end after find SSID match AP.

                If "All Channel" is selected, scan will end after scan all the channel.

            config EXAMPLE_WIFI_SCAN_METHOD_FAST
                bool "Fast"
            config EXAMPLE_WIFI_SCAN_METHOD_ALL_CHANNEL
                bool "All Channel"
        endchoice

        menu "WiFi Scan threshold"
            config EXAMPLE_WIFI_SCAN_RSSI_THRESHOLD
                int "WiFi minimum rssi"
                range -127 0

                default -127
                help
                    The minimum rssi to accept in the scan mode.

            choice EXAMPLE_WIFI_SCAN_AUTH_MODE_THRESHOLD
                prompt "WiFi Scan auth mode threshold"
                default EXAMPLE_WIFI_AUTH_OPEN
                help
                    The weakest authmode to accept in the scan mode.

                config EXAMPLE_WIFI_AUTH_OPEN
                    bool "OPEN"
                config EXAMPLE_WIFI_AUTH_WEP
                    bool "WEP"
                config EXAMPLE_WIFI_AUTH_WPA_PSK
                    bool "WPA PSK"
                config EXAMPLE_WIFI_AUTH_WPA2_PSK
                    bool "WPA2 PSK"
                config EXAMPLE_WIFI_AUTH_WPA_WPA2_PSK
                    bool "WPA WPA2 PSK"
                config EXAMPLE_WIFI_AUTH_WPA2_ENTERPRISE
                    bool "WPA2 ENTERPRISE"
                config EXAMPLE_WIFI_AUTH_WPA3_PSK
                    bool "WPA3 PSK"
                config EXAMPLE_WIFI_AUTH_WPA2_WPA3_PSK
                    bool "WPA2 WPA3 PSK"
                config EXAMPLE_WIFI_AUTH_WAPI_PSK
                    bool "WAPI PSK"
            endchoice
        endmenu

        choice EXAMPLE_WIFI_CONNECT_AP_SORT_METHOD
            prompt "WiFi Connect AP Sort Method"
            default EXAMPLE_WIFI_CONNECT_AP_BY_SIGNAL
            help
                WiFi connect AP sort method:

                If "Signal" is selected, Sort matched APs in scan list by RSSI.

                If "Security" is selected, Sort matched APs in scan list by security mode.

            config EXAMPLE_WIFI_CONNECT_AP_BY_SIGNAL
                bool "Signal"
            config EXAMPLE_WIFI_CONNECT_AP_BY_SECURITY
                bool "Security"
        endchoice
    endif

endmenu
```
